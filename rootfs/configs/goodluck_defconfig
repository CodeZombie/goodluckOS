## rootfs/configs/goodluck_defconfig
```kconfig
BR2_arm=y
BR2_cortex_a7=y
BR2_ARM_FPU_NEON_VFPV4=y
BR2_ARM_INSTRUCTIONS_THUMB2=y
BR2_KERNEL_HEADERS_6_12=y
BR2_TOOLCHAIN_BUILDROOT_CXX=y
BR2_GCC_ENABLE_OPENMP=y
BR2_TARGET_OPTIMIZATION="-march=armv7-a -mtune=cortex-a7 -mfpu=neon-vfpv4 -mfloat-abi=hard -ftree-vectorize"
BR2_CCACHE=y
BR2_TARGET_GENERIC_HOSTNAME="goodluckOS"
BR2_TARGET_GENERIC_ISSUE="Oh No! It's goodluckOS!"
BR2_ROOTFS_DEVICE_CREATION_DYNAMIC_EUDEV=y
BR2_ROOTFS_DEVICE_TABLE="system/device_table.txt $(BR2_EXTERNAL_GOODLUCKOS_PATH)/board/my-device/permissions.txt"
BR2_TARGET_GENERIC_ROOT_PASSWD="root"
# BR2_TARGET_GENERIC_REMOUNT_ROOTFS_RW is not set
BR2_ROOTFS_USERS_TABLES="../board/my-device/users.txt"
BR2_ROOTFS_OVERLAY="../board/my-device/rootfs-overlay/"
BR2_ROOTFS_POST_BUILD_SCRIPT="../board/my-device/post-build.sh"
BR2_PACKAGE_BUSYBOX_CONFIG="$(BR2_EXTERNAL_GOODLUCKOS_PATH)/configs/.busybox-config"
BR2_PACKAGE_BUSYBOX_SHOW_OTHERS=y
BR2_PACKAGE_ALSA_UTILS=y
BR2_PACKAGE_ALSA_UTILS_AMIXER=y
BR2_PACKAGE_ALSA_UTILS_APLAY=y
BR2_PACKAGE_ALSA_UTILS_APLAYMIDI=y
BR2_PACKAGE_ALSA_UTILS_SPEAKER_TEST=y
BR2_PACKAGE_BROTLI=y
BR2_PACKAGE_DOSFSTOOLS=y
BR2_PACKAGE_DOSFSTOOLS_MKFS_FAT=y
BR2_PACKAGE_CHOCOLATE_DOOM=y
BR2_PACKAGE_DOOM_WAD=y
BR2_PACKAGE_DRM_INFO=y
BR2_PACKAGE_MESA3D=y
BR2_PACKAGE_MESA3D_GALLIUM_DRIVER_LIMA=y
BR2_PACKAGE_MESA3D_OPENGL_EGL=y
BR2_PACKAGE_MESA3D_OPENGL_ES=y
BR2_PACKAGE_SDL=y
BR2_PACKAGE_SDL_MIXER=y
BR2_PACKAGE_SDL_NET=y
BR2_PACKAGE_SDL2_KMSDRM=y
BR2_PACKAGE_SDL2_OPENGLES=y
BR2_PACKAGE_SDL2_MIXER=y
BR2_PACKAGE_SDL2_NET=y
BR2_PACKAGE_SDL3=y
BR2_PACKAGE_SDL3_KMSDRM=y
BR2_PACKAGE_SDL3_OPENGLES=y
BR2_PACKAGE_SDL3_GFX=y
BR2_PACKAGE_SDL3_IMAGE=y
BR2_PACKAGE_SDL3_TTF=y
BR2_PACKAGE_DBUS=y
BR2_PACKAGE_EVTEST=y
BR2_PACKAGE_TRIGGERHAPPY=y
BR2_PACKAGE_OPENSSL=y
BR2_PACKAGE_JPEG=y
BR2_PACKAGE_LIBPNG=y
BR2_PACKAGE_JSONCPP=y
BR2_PACKAGE_YAML_CPP=y
BR2_PACKAGE_PCRE2_16=y
# BR2_PACKAGE_IFUPDOWN_SCRIPTS is not set
BR2_PACKAGE_OPENDOAS=y
BR2_PACKAGE_BUBBLEWRAP=y
BR2_PACKAGE_CRUN=y
BR2_PACKAGE_PODMAN=y
BR2_PACKAGE_RUNC=y
BR2_PACKAGE_TAR=y
BR2_PACKAGE_UTIL_LINUX_BINARIES=y
BR2_PACKAGE_UTIL_LINUX_PARTX=y
BR2_PACKAGE_UTIL_LINUX_UNSHARE=y
BR2_PACKAGE_NANO=y
BR2_PACKAGE_HOST_KMOD=y
BR2_PACKAGE_RETROARCH=y
BR2_PACKAGE_RETROARCH_EGL=y
BR2_PACKAGE_RETROARCH_GLES=y
BR2_PACKAGE_RETROARCH_KMS=y
BR2_PACKAGE_RETROARCH_SDL2=y
BR2_PACKAGE_RETROARCH_RGUI_MENU=y
BR2_PACKAGE_LIBRETRO_CORES=y
BR2_PACKAGE_PUPPY=y
BR2_PACKAGE_ARE_YOU_SURE=y
BR2_PACKAGE_SYSTEM_SETTINGS=y
BR2_PACKAGE_RESIZE_HOME=y
BR2_PACKAGE_PPSSPP=y
```

## rootfs/package/Config.in
```kconfig
menu "goodluckOS Custom Packages"
source "../package/imgui/Config.in"
source "../package/retroarch/Config.in"
source "../package/libretro-cores/Config.in"
source "../package/puppy/Config.in"
source "../package/are-you-sure/Config.in"
source "../package/system-settings/Config.in"
source "../package/resize-home/Config.in"
source "../package/ppsspp/Config.in"
endmenu
```

## rootfs/package/app-installer/Config.in
```kconfig
config BR2_PACKAGE_APP_INSTALLER
	bool "app-installer"
	depends on BR2_INSTALL_LIBSTDCPP
	select BR2_PACKAGE_SDL2
	select BR2_PACKAGE_SDL2_IMAGE
	select BR2_PACKAGE_IMGUI
	select BR2_PACKAGE_ZLIB
	help
	  Installs apps from .zip files in HOME/apps, and uninstalls them.

comment "app-installer needs a toolchain w/ C++"
	depends on !BR2_INSTALL_LIBSTDCPP
```

## rootfs/package/are-you-sure/Config.in
```kconfig
config BR2_PACKAGE_ARE_YOU_SURE
	bool "are-you-sure"
	depends on BR2_INSTALL_LIBSTDCPP
	select BR2_PACKAGE_SDL2
	select BR2_PACKAGE_IMGUI
	help
	  Are You Sure Script Launcher Application

comment "are-you-sure needs a toolchain w/ C++"
	depends on !BR2_INSTALL_LIBSTDCPP
```

## rootfs/package/credits/Config.in
```kconfig
config BR2_PACKAGE_CREDITS
	bool "CREDITS"
	depends on BR2_INSTALL_LIBSTDCPP # C++ is required
	select BR2_PACKAGE_SDL2
	select BR2_PACKAGE_SDL2_TTF
	help
	  Credits Visualizer.

comment "credits needs a toolchain w/ C++"
	depends on !BR2_INSTALL_LIBSTDCPP
```

## rootfs/package/dsperate/Config.in
```kconfig
config BR2_PACKAGE_DSPERATE
	bool "dsperate"
	depends on BR2_INSTALL_LIBSTDCPP
	depends on BR2_TOOLCHAIN_GCC_AT_LEAST_8 # C++17 requirement
	depends on BR2_TOOLCHAIN_HAS_THREADS
	help
	  DSperate is a Nintendo DS emulator.

	  This package will automatically build the SDL2 frontend
	  if BR2_PACKAGE_SDL2 is enabled in your configuration.

	  https://github.com/beebono/DSperate

comment "dsperate needs a toolchain w/ C++, threads, gcc >= 8"
	depends on !BR2_INSTALL_LIBSTDCPP || \
		!BR2_TOOLCHAIN_HAS_THREADS || \
		!BR2_TOOLCHAIN_GCC_AT_LEAST_8
```

## rootfs/package/evsieve/Config.in
```kconfig
config BR2_PACKAGE_EVSIEVE
	bool "evsieve"
	depends on BR2_PACKAGE_HOST_RUSTC_TARGET_ARCH_SUPPORTS
	select BR2_PACKAGE_HOST_RUSTC
	select BR2_PACKAGE_LIBEVDEV
	help
	  Evsieve is a low-level utility that can read events from
	  Linux event devices (evdev), remap, filter and merge them,
	  and write them to virtual input devices.

	  https://github.com/KarsMulder/evsieve
```

## rootfs/package/gallery/Config.in
```kconfig
config BR2_PACKAGE_GALLERY
	bool "gallery"
	depends on BR2_INSTALL_LIBSTDCPP
	select BR2_PACKAGE_SDL2
	select BR2_PACKAGE_SDL2_IMAGE
	select BR2_PACKAGE_IMGUI
	help
	  Browse the screenshots and recordings RetroArch saved.

comment "gallery needs a toolchain w/ C++"
	depends on !BR2_INSTALL_LIBSTDCPP
```

## rootfs/package/imgui/Config.in
```kconfig
config BR2_PACKAGE_IMGUI
	bool "imgui"
	depends on BR2_INSTALL_LIBSTDCPP
	select BR2_PACKAGE_SDL2
	help
	  Dear ImGui: Bloat-free Graphical User interface for C++ with minimal dependencies.

	  This package builds ImGui as a shared library (.so) including
	  the SDL2 and SDLRenderer2 backends.

	  https://github.com/ocornut/imgui

comment "imgui needs a toolchain w/ C++"
	depends on !BR2_INSTALL_LIBSTDCPP
```

## rootfs/package/libretro-cores/Config.in
```kconfig
config BR2_PACKAGE_LIBRETRO_CORES
	bool "libretro-cores"
	depends on BR2_PACKAGE_ZLIB
	help
	  Compiles libretro cores from
	  https://github.com/libretro/libretro-super
```

## rootfs/package/ppsspp/Config.in
```kconfig
config BR2_PACKAGE_PPSSPP
	bool "ppsspp (libretro core)"
	depends on BR2_INSTALL_LIBSTDCPP
	depends on BR2_TOOLCHAIN_HAS_THREADS
	depends on BR2_TOOLCHAIN_GCC_AT_LEAST_9 # C++17
	depends on BR2_PACKAGE_HAS_LIBGLES
	depends on BR2_arm || BR2_aarch64 || BR2_x86_64
	select BR2_PACKAGE_ZLIB
	help
	  PPSSPP libretro core (ppsspp_libretro.so), a PSP emulator.

	  https://github.com/hrydgard/ppsspp

comment "ppsspp needs a toolchain w/ C++, threads, gcc >= 9, and a GLES provider"
	depends on BR2_arm || BR2_aarch64 || BR2_x86_64
	depends on !BR2_INSTALL_LIBSTDCPP || !BR2_TOOLCHAIN_HAS_THREADS || \
		!BR2_TOOLCHAIN_GCC_AT_LEAST_9 || !BR2_PACKAGE_HAS_LIBGLES
```

## rootfs/package/puppy/Config.in
```kconfig
config BR2_PACKAGE_PUPPY
	bool "puppy"
	depends on BR2_INSTALL_LIBSTDCPP # C++ is required
	select BR2_PACKAGE_SDL2
	select BR2_PACKAGE_SDL2_IMAGE
	select BR2_PACKAGE_SDL2_TTF
	select BR2_PACKAGE_SDL2_GFX
	help
	  The Puppy Launcher.

comment "puppy needs a toolchain w/ C++"
	depends on !BR2_INSTALL_LIBSTDCPP
```

## rootfs/package/resize-home/Config.in
```kconfig
config BR2_PACKAGE_RESIZE_HOME
	bool "resize-home"
	depends on BR2_INSTALL_LIBSTDCPP
	select BR2_PACKAGE_SDL2
	select BR2_PACKAGE_IMGUI
	help
	  System Settings Application

comment "resize-home needs a toolchain w/ C++"
	depends on !BR2_INSTALL_LIBSTDCPP
```

## rootfs/package/system-settings/Config.in
```kconfig
config BR2_PACKAGE_SYSTEM_SETTINGS
	bool "system-settings"
	depends on BR2_INSTALL_LIBSTDCPP
	select BR2_PACKAGE_SDL2
	select BR2_PACKAGE_IMGUI
	help
	  System Settings Application

comment "system-settings needs a toolchain w/ C++"
	depends on !BR2_INSTALL_LIBSTDCPP
```

## rootfs/package/vitrine/Config.in
```kconfig
config BR2_PACKAGE_VITRINE
	bool "vitrine"
	depends on BR2_INSTALL_LIBSTDCPP # C++ is required
	select BR2_PACKAGE_SDL2
	select BR2_PACKAGE_SDL2_IMAGE
	select BR2_PACKAGE_SDL2_TTF
	help
	  Vitrine, an optional alternative game launcher.
	  It reads the same apps.puppy files as Puppy.

comment "vitrine needs a toolchain w/ C++"
	depends on !BR2_INSTALL_LIBSTDCPP
```
