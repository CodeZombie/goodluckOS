## rootfs/package/ini-lua/Config.in
```kconfig
config BR2_PACKAGE_INI_LUA
	bool "ini-lua"
	depends on BR2_PACKAGE_LUAJIT
	help

	  https://github.com/lzubiaur/ini.lua

comment "ini-lua needs LuaJIT"
	depends on !BR2_PACKAGE_LUAJIT
```

## rootfs/package/libubox-lua/Config.in
```kconfig
config BR2_PACKAGE_LIBUBOX_LUA
	bool "libubox-lua"
	depends on BR2_PACKAGE_HAS_LUAINTERPRETER
	depends on BR2_PACKAGE_LUA_5_1 || BR2_PACKAGE_LUAJIT
	depends on !BR2_STATIC_LIBS # dlopen / Lua C modules
	select BR2_PACKAGE_LIBUBOX
	help
	  Lua bindings (uloop.so) for OpenWrt's libubox event loop.

	  https://git.openwrt.org/project/libubox.git

comment "libubox-lua needs Lua 5.1 or LuaJIT and dynamic library support"
	depends on !BR2_PACKAGE_HAS_LUAINTERPRETER || \
		!(BR2_PACKAGE_LUA_5_1 || BR2_PACKAGE_LUAJIT) || \
		BR2_STATIC_LIBS
```

## rootfs/package/libubus-lua/Config.in
```kconfig
config BR2_PACKAGE_LIBUBUS_LUA
	bool "libubus-lua"
	depends on BR2_PACKAGE_HAS_LUAINTERPRETER
	depends on BR2_PACKAGE_LUAJIT
	depends on !BR2_STATIC_LIBS # dlopen / Lua C modules
	select BR2_PACKAGE_LIBUBOX
	select BR2_PACKAGE_UBUS
	help
	  Lua bindings (ubus.so) for OpenWrt's micro-bus architecture
	  (ubus).

	  https://git.openwrt.org/project/ubus.git

comment "libubus-lua needs Lua 5.1 or LuaJIT and dynamic library support"
	depends on !BR2_PACKAGE_HAS_LUAINTERPRETER || \
		!(BR2_PACKAGE_LUAJIT) || \
		BR2_STATIC_LIBS
```

## rootfs/package/menui/Config.in
```kconfig
config BR2_PACKAGE_MENUI
	bool "menui"
	depends on BR2_INSTALL_LIBSTDCPP
	depends on BR2_PACKAGE_LUAJIT
	depends on BR2_PACKAGE_SDL2
	select BR2_PACKAGE_SDL2_TTF
	help
	  menui is an immediate-mode UI library for LuaJIT, with a
	  C++ SDL2 rendering backend accessed through the LuaJIT FFI.

	  Installs libmenui.so to /usr/lib and menui.lua to
	  /usr/share/lua/5.1.

comment "menui needs a toolchain w/ C++, LuaJIT and SDL2"
	depends on !BR2_INSTALL_LIBSTDCPP || !BR2_PACKAGE_LUAJIT || !BR2_PACKAGE_SDL2
```
